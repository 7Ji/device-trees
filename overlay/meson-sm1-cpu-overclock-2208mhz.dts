/dts-v1/;
/plugin/;

&cpu_opp_table {
	opp-2100000000 {
		opp-hz = /bits/ 64 <2100000000>;
		opp-microvolt = <1011000>;
	};

	opp-2208000000 {
		opp-hz = /bits/ 64 <2208000000>;
		opp-microvolt = <1021000>;
	};
};